## so3/arch/arm/Kconfig
```kconfig
menu "Platform"

choice
	prompt "SO3 OS type"

config STANDALONE
        bool "Standalone OS"
        
endchoice

choice
  prompt "Target"
	
       	depends on STANDALONE
	config VEXPRESS
    	bool "Vexpress"
   
endchoice

source "arch/arm/vexpress/Kconfig"

endmenu
```

## so3/devices/timer/Kconfig
```kconfig
config SP804
	bool "DesignWare APB UART"
	depends on VEXPRESS
	
config SUN4I_TIMER
	bool "SUN4i timer"
	depends on PINE64 || A20 || MERIDAv2 || BPI

	
config ARM_CLOCKSOURCE
	bool "ARM architected CP15 clocksource"
```

## so3/kernel/Kconfig
```kconfig
choice
	prompt "SO3 Scheduling policy"

	config SCHED_RR
		bool "Sched policy Round-Robin (normal)"


        config SCHED_PRIO
		bool "Sched policy with a simple priority based"
endchoice
```
